## drivers/misc/sensors/Kconfig
```kconfig
#
# Sensor Misc devices
#
config MMA7455
	tristate "MMA7455 Driver Support"
	depends on I2C
	default yes
	help
	  This option enables MMA7455 G-sensor support.

	  To compile this driver as a module, choose M here: the module will
	  be called mma7455.

config ECOMPASS
	tristate "MEMSIC eCompass Driver Support"
	depends on I2C
	default yes
	help
	  This option enables MEMSIC eCompass support.

	  To compile this driver as a module, choose M here: the module will
	  be called mecs.
```

## drivers/staging/thermal_framework/sensor/Kconfig.omap
```kconfig
#
# Thermal Temp sensor configuration
#

config OMAP4_DIE_TEMP_SENSOR
	tristate "OMAP On-Die temp sensor support"
	depends on OMAP_THERMAL && OMAP_TEMP_SENSOR
	help
	  Enabling this config will give support for the on-die
	  temp sensor for the OMAP platform.

config OMAP4_PCB_SENSOR
	tristate "OMAP PCB temp sensor support"
	depends on OMAP_THERMAL
	help
	  Enabling this config will give support for the pcb
	  temp sensor for the OMAP platform.

config OMAP4_TMP102_SENSOR
	tristate "OMAP TMP102 temp sensor support"
	depends on OMAP_THERMAL
	help
	  Enabling this config will give support for the tmp102
	  temp sensor for the OMAP platform.
```
